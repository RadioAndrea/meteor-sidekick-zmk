## boards/shields/meteor-sidekick/Kconfig.defconfig
```kconfig
# Copyright (c) 2020 The ZMK Contributors
# SPDX-License-Identifier: MIT

if SHIELD_METEOR_SIDEKICK

config ZMK_KEYBOARD_NAME
    default "meteor_sidekick"

endif
```

## boards/shields/meteor-sidekick/Kconfig.shield
```kconfig
# Copyright (c) 2020 The ZMK Contributors
# SPDX-License-Identifier: MIT

config SHIELD_METEOR_SIDEKICK
    def_bool $(shields_list_contains,meteor_sidekick)
```
